// SPDX-License-Identifier: BSD-3-Clause

/*
 * Copyright (c) Qualcomm Technologies, Inc. and/or its subsidiaries.
 */

/dts-v1/;
/plugin/;

#include "alor-nfc-common-eletre-gpios.dtsi"
/ {
        model = "eletre";
        compatible = "qcom,alor";
        qcom,msm-id = <685 0x10000>, <727 0x10000>;
        qcom,board-id = <0x4A 0x9000>;
};

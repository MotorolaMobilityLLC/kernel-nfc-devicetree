/dts-v1/;
/plugin/;

#include "pitti-nfc-common-pinctrl.dtsi"
/ {
	model = "Qualcomm Technologies, Inc. Pitti SoC";
	compatible = "qcom,pitti";
	qcom,msm-id = <623 0x10000>;
	qcom,board-id = <33 0>, <34 0>;
};

// SPDX-License-Identifier: BSD-3-Clause

/*
 * Copyright (c) Qualcomm Technologies, Inc. and/or its subsidiaries.
 */

/dts-v1/;
/plugin/;

#include "alor-nfc-common-makalu-gpios.dtsi"
/ {
        model = "makalu";
        compatible = "qcom,alor";
        qcom,msm-id = <685 0x10000>, <727 0x10000>;
        qcom,board-id = <0x46 0x9000>, <0x48 0x9100>;
};

/dts-v1/;
/plugin/;

#include "volcano-nfc-common-gpios.dtsi"

/ {
	model = "Qualcomm Technologies, Inc. Volcano6I QRD +  WCD9378 AMIC + Amoled (SPI) + Moselle";
	compatible = "qcom,volcano-qrd", "qcom,volcano", "qcom,volcanop-qrd", "qcom,volcanop", "qcom,qrd";
	qcom,msm-id = <657 0x10000>, <658 0x10000>, <0X10291 0x10000>, <0x10292 0x10000>, <0x20291 0x10000>, <0x20292 0x10000>, <0x30291 0x10000>, <0x30292 0x10000>, <0x40291 0x10000>, <0x40292 0x10000>;
	qcom,board-id = <11 1>;
};

// SPDX-License-Identifier: BSD-3-Clause

/*
 * Copyright (c) Qualcomm Technologies, Inc. and/or its subsidiaries.
 */

/dts-v1/;
/plugin/;

#include "alor-nfc-common-avr-gpios.dtsi"
/ {
        model = "avr";
        compatible = "qcom,alor";
        qcom,msm-id = <685 0x10000>, <727 0x10000>;
        qcom,board-id = <0x45 0x9100>;
};
